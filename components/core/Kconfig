## components/core/Kconfig
```kconfig
menu "DNS Sinkhole"

    config SINKHOLE_HOSTNAME
        string "Hostname (mDNS name, without .local)"
        default "sinkhole"

    config SINKHOLE_AP_PASSWORD
        string "Default setup access point password (min 8 chars)"
        default "sinkhole-setup"
        help
            WPA2 password of the device's own access point. Change it from the web UI.

    config SINKHOLE_ADMIN_USER
        string "Default web admin user"
        default "admin"

    config SINKHOLE_ADMIN_PASSWORD
        string "Default web admin password"
        default "sinkhole"
        help
            The web UI shows a warning while this default is still in use.

    config SINKHOLE_UPSTREAM_DNS
        string "Default upstream DNS resolver (IPv4)"
        default "9.9.9.9"

    config SINKHOLE_BLOCKLIST_URL
        string "Default blocklist URL"
        default "https://github.com/joanrra2/pocket-adblock/releases/download/blocklist/blocklist.bin"
        help
            The project's daily lists (blocklist.bin, -light, -aggressive, -extended
            in a release named "blocklist") are fetched in their fuse-filter
            version (blocklist-v4.bin and so on), falling back to the named file.
            The setting keeps the original name, which older firmware can read.
            Raw (headerless) lists from esp32-c3-adblock and SHBL v1/v2/v4 lists
            from tools/build_blocklist.py are accepted. Leave empty to disable.

    config SINKHOLE_BLOCKLIST_UPDATE_HOURS
        int "Hours between automatic blocklist updates (0 = off)"
        default 6
        range 0 720

    config SINKHOLE_BLOCKLIST_PUBKEY
        string "Blocklist signing public key (hex, empty = no verification)"
        default ""
        help
            Uncompressed ECDSA P-256 public key (130 hex characters, from
            tools/keys.py blocklist-key). Signed lists are verified against it;
            a list whose signature does not verify is rejected.

    config SINKHOLE_BLOCKLIST_REQUIRE_SIGNED
        bool "Reject unsigned blocklists"
        default n
        help
            Only accept lists signed with SINKHOLE_BLOCKLIST_PUBKEY. Raw lists from
            esp32-c3-adblock and unsigned SHBL lists are refused.

    config SINKHOLE_FW_MANIFEST_URL
        string "Default firmware update manifest URL (empty = no checks)"
        default ""
        help
            JSON written by the release workflow: {"version": "x.y.z",
            "images": {"<board id>": "<url of the OTA image>", ...}}. Checked daily.

    config SINKHOLE_BOARD_ID
        string "Board id used to pick the image from the update manifest"
        default ""
        help
            Empty = the chip target (esp32c3, esp32s3, ...). Board profiles set
            their own id, e.g. esp32s3-octal-flash.

    config SINKHOLE_FLAVOUR
        string "Edition (set from the features file, don't edit)"
        default "custom"
        help
            lite / pro for the release editions (flavours/*.cfg), custom for
            builds made with FEATURES.cfg. Release images are looked up as
            <board> (lite) or <board>-pro; custom builds never auto-install.

    config SINKHOLE_MAX_CLIENTS
        int "Tracked DNS clients"
        default 64
        range 8 256

    config SINKHOLE_MAX_LOCAL_RECORDS
        int "Local DNS names and forward rules"
        default 24
        range 4 256
        help
            Fixed addresses (nas.home -> 192.168.1.10) and forward rules (lan -> router).
            56 bytes of RAM each.

    config SINKHOLE_MAX_CUSTOM_DOMAINS
        int "Custom block / allow entries (each list)"
        default 64
        range 8 512

    config SINKHOLE_DNS_MAX_PENDING
        int "Concurrent upstream DNS queries"
        default 32
        range 4 128

    config SINKHOLE_DNS_UPSTREAM_TIMEOUT_MS
        int "Upstream DNS timeout (ms)"
        default 2000
        range 200 10000

    config SINKHOLE_DNS_CACHE_PSRAM
        int "DNS answer cache entries when PSRAM is present"
        default 4096
        range 0 16384
        help
            ~530 bytes each. A hit answers in microseconds instead of an upstream
            round trip. Halved automatically until it fits the free PSRAM.

    config SINKHOLE_DNS_CACHE_INTERNAL
        int "DNS answer cache entries without PSRAM (0 = no cache)"
        default 32
        range 0 512

    config SINKHOLE_DNS_CACHE_MAX_TTL
        int "Cap cached answers at this many seconds"
        default 3600
        range 30 86400

    config SINKHOLE_DNS_CACHE_MIN_TTL
        int "Keep short-lived answers cached for at least this many seconds"
        default 30
        range 0 300
        help
            Some resolvers answer with TTL 0 (or a few seconds), which would make
            every repeat query wait for the upstream again. Answers below this
            floor are still cached for this long, but clients are always told the
            upstream's remaining TTL (at least 1 s), so they never hold an answer
            longer than the upstream asked. 0 disables the floor (TTL-0 answers
            are then never cached).

    config SINKHOLE_QUERY_HISTORY_EXTENDED
        bool "Long query history (uses extra RAM, PSRAM recommended)"
        default n
        help
            Off: the last 32 queries are kept in internal RAM (2.4 KB).
            On: keep SINKHOLE_QUERY_HISTORY_ENTRIES queries (76 bytes each), allocated
            once at boot in PSRAM when present, halved until it fits, falling back to
            32 entries. Makes the per-device view useful for finding what a blocklist
            breaks. Recommended for boards with PSRAM (ESP32-S3 N8R8/N16R8/N32R16V,
            WROVER); leave off on the ESP32-C3.

    config SINKHOLE_QUERY_HISTORY_ENTRIES
        int "Query history entries"
        depends on SINKHOLE_QUERY_HISTORY_EXTENDED
        default 2048
        range 64 32768

    config SINKHOLE_DNS_OVER_TLS
        bool "Encrypted upstream: DNS over TLS (uses ~40 KB RAM)"
        default n
        help
            Adds Settings -> Upstream DNS -> "Encrypt with DNS over TLS": allowed
            queries go to the provider over one TLS connection (port 853), so the
            ISP can't read or change them. Costs ~40 KB of RAM for the TLS session
            while connected, plus a 6 KB task stack.
            Recommended: boards with PSRAM (ESP32-S3 / WROVER). Not recommended on
            the ESP32-C3: it needs that RAM for HTTPS updates.

    config SINKHOLE_TOP_DOMAINS
        bool "Top domains statistics (PSRAM only)"
        default n
        help
            Counts the most-queried allowed and blocked domains since boot and shows
            them on the overview. ~60 bytes of PSRAM per counter; turns itself off
            on boards without PSRAM. Top clients are always available (they use
            the client table that already exists).

    config SINKHOLE_TOP_DOMAINS_ENTRIES
        int "Domain counters"
        depends on SINKHOLE_TOP_DOMAINS
        default 2048
        range 256 16384

    config SINKHOLE_BLOOM_FILTER
        bool "RAM bloom filter in front of the flash blocklist (uses extra RAM)"
        default n
        help
            Keeps a bloom filter of the blocklist in RAM so most domains that are
            NOT listed are answered without reading flash. Sized for the slot
            capacity at boot: about BITS_PER_ENTRY/8 bytes per domain
            (10 bits: ~270 KB for the 4 MB layout, ~1 MB for the 8 MB layout).
            Allocated in PSRAM when present, otherwise in internal RAM only if it
            fits; if allocation fails the firmware runs without it.
            Only sorted lists (SHBL v1/v2, raw) use it, and it is allocated the
            first time one becomes active: fuse-filter lists (v4, the default)
            answer in 3 flash reads and leave this RAM free.
            Recommended: ESP32-S3 / ESP32 boards with PSRAM. Not recommended on the
            ESP32-C3: it would take the internal RAM that HTTPS updates need.

    config SINKHOLE_BLOOM_BITS_PER_ENTRY
        int "Bloom filter bits per domain"
        depends on SINKHOLE_BLOOM_FILTER
        default 10
        range 4 24
        help
            10 bits = ~1% false positives (those just fall through to the flash
            lookup, so results are always exact).

    config SINKHOLE_WOL_MAX_HOSTS
        int "Wake-on-LAN hosts"
        default 16
        range 1 64

    config SINKHOLE_BOOT_BUTTON_GPIO
        int "BOOT button GPIO (-1 = none)"
        default 9 if IDF_TARGET_ESP32C3 || IDF_TARGET_ESP32C6 || IDF_TARGET_ESP32C2
        default 0
        range -1 48
        help
            Hold 3 s: turn the setup access point on for 15 minutes.
            Hold 10 s: factory reset (erases settings, keeps the blocklist).

    config SINKHOLE_WIFI_MAX_TX_POWER
        int "Pin Wi-Fi TX power in 0.25 dBm units (0 = runtime setting)"
        default 0
        range 0 84
        help
            0 (default): TX power is chosen at runtime in Settings: Auto (full power,
            falls back to 8.5 dBm after repeated failures), Full or Reduced.
            Some C3 SuperMini boards have a badly matched antenna and drop the
            connection at full power; 34 (= 8.5 dBm) pins the reduced level.

endmenu
```
